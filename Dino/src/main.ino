// Dino Game for ESP LilyGO T-Display
// This project is a T-Rex game that was inspired by Google Chrome's offline game.
// Copyright (c) Gonzalez Harilanto ANDRINIRINA, October 2025.

#include <TFT_eSPI.h>   
#include "gameover.h" 
#include "noInternet.h"
#include "ptero_enemy.h"

TFT_eSPI    tft = TFT_eSPI();        
TFT_eSprite img = TFT_eSprite(&tft);
TFT_eSprite img2 = TFT_eSprite(&tft);
TFT_eSprite e = TFT_eSprite(&tft); // Sprite for enemies (obstacles)
TFT_eSprite e2 = TFT_eSprite(&tft); // Sprite for additional enemy
TFT_eSprite ptero = TFT_eSprite(&tft); // Sprite for pterodactyl enemy

// `dino` stores the bitmap representation of the dinosaur in different frames
// PROGMEM keyword stores it in flash memory (not SRAM) to save space
PROGMEM unsigned char dino[][1155] = {{ /* Bitmap data for first frame of dino */
  0x00, 0x00, 0xF8, 0x3F, 0x00, 0x00, 0x00, 0xFC, 0x7F, 0x00, 0x00, 0x00, 
  0xFE, 0xFF, 0x01, 0x00, 0x00, 0xEE, 0xFF, 0x01, 0x00, 0x00, 0xFE, 0xFF, 
  0x01, 0x00, 0x00, 0xFE, 0xFF, 0x01, 0x00, 0x00, 0xFE, 0xFF, 0x01, 0x00, 
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  0x0E, 0x03, 0x00, 0x00, 0x00, 0x06, 0x03, 0x00, 0x00, 0x00, 0x06, 0x07, 
  0x00, 0x00, 0x00, 0x1E, 0x0F, 0x00, 0x00, },{ /* Bitmap for second frame of dino */
  0x00, 0x00, 0xF8, 0x3F, 0x00, 0x00, 0x00, 0xFC, 0x7F, 0x00, 0x00, 0x00, 
  0xFE, 0xFF, 0x01, 0x00, 0x00, 0xEE, 0xFF, 0x01, 0x00, 0x00, 0xFE, 0xFF, 
  0x01, 0x00, 0x00, 0xFE, 0xFF, 0x01, 0x00, 0x00, 0xFE, 0xFF, 0x01, 0x00, 
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  0x0E, 0x0F, 0x00, 0x00, 0x00, 0x06, 0x00, 0x00, 0x00, 0x00, 0x06, 0x00, 
  0x00, 0x00, 0x00, 0x1E, 0x00, 0x00, 0x00, },{ /* Bitmap for third frame of dino */
  0x00, 0x00, 0xF8, 0x3F, 0x00, 0x00, 0x00, 0xFC, 0x7F, 0x00, 0x00, 0x00, 
  0xFE, 0xFF, 0x01, 0x00, 0x00, 0xEE, 0xFF, 0x01, 0x00, 0x00, 0xFE, 0xFF, 
  0x01, 0x00, 0x00, 0xFE, 0xFF, 0x01, 0x00, 0x00, 0xFE, 0xFF, 0x01, 0x00, 
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  0x00, 0x00, 0x00, 0x00, 0x0F, 0x00, 0x00, }
};

// Bitmap data for clouds in the background
PROGMEM unsigned char cloud[] = {
  0x00, 0x00, 0x7C, 0x00, 0x00, 0x00, 0x80, 0xCF, 0x01, 0x00, 0x00, 0xE0, 
  0x01, 0x03, 0x00, 0x00, 0x60, 0x00, 0x0F, 0x00, 0x00, 0x38, 0x00, 0xFE, 
  0x00, 0x00, 0x3C, 0x30, 0xA8, 0x03, 0xE0, 0x0F, 0x00, 0x80, 0x07, 0x70, 
  0x05, 0x03, 0x00, 0x0E, 0x18, 0x00, 0x00, 0x02, 0x08, 0x0E, 0x00, 0x00, 
  0x00, 0x18, 0xFF, 0xFF, 0xFF, 0xFF, 0x3F, };

// Bitmap data for bumps (ground obstacles)
PROGMEM unsigned char bump[][170] = {{
  0xC0, 0x01, 0x00, 0x1E, 0x00, 0x30, 0x03, 0x00, 0x33, 0x00, 0x1C, 0x0E, 
  0xC0, 0xE0, 0x00, 0x06, 0x18, 0xF0, 0x80, 0x01, 0x03, 0xF0, 0x1F, 0x00, 
  0x03, },{
  0x00, 0x00, 0x00, 0x00, 0x00, 0xC0, 0x01, 0x00, 0x00, 0x00, 0x30, 0x0E, 
  0xC0, 0x00, 0x00, 0x18, 0x98, 0xF3, 0xC1, 0x01, 0x07, 0xF0, 0x1F, 0x3E, 
  0x03,}};

// Bitmap data for enemies (like birds or cacti)
PROGMEM unsigned char enemy[][684] =  {{ 0x00, 0x03, 0x00, 0x80, 0x07, 0x00, 0xC0, 0x0F, 0x00, 0xC0, 0x0F, 0x00, 
  0xC0, 0x0F, 0x00, 0xC0, 0x0F, 0x00, 0xC0, 0x0F, 0x00, 0xC0, 0x0F, 0x00, 
  0xC0, 0x0F, 0x00, 0xC0, 0x0F, 0x00, 0xC0, 0x8F, 0x01, 0xC6, 0xCF, 0x03, 
  0xCF, 0xCF, 0x03, 0xCF, 0xCF, 0x03, 0xCF, 0xCF, 0x03, 0xCF, 0xCF, 0x03, 
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  0xC0, 0x0F, 0x00, 0xC0, 0x0F, 0x00, 0xC0, 0x0F, 0x00, 0xC0, 0x0F, 0x00, 
  0xC0, 0x0F, 0x00, 0xC0, 0x0F, 0x00, },{
  0x00, 0x00, 0x00, 0x00, 0x00, 0x00, 0x00, 0x00, 0x00, 0x00, 0x00, 0x00, 
  0x00, 0x00, 0x00, 0x00, 0x01, 0x00, 0x80, 0x03, 0x00, 0xC0, 0x07, 0x00, 
  0xC0, 0x07, 0x00, 0xC0, 0x07, 0x00, 0xC0, 0x47, 0x00, 0xC0, 0xE7, 0x00, 
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  0xC0, 0x07, 0x00, 0xC0, 0x07, 0x00, }};

const int pwmFreq = 5000;
const int pwmResolution = 8;
const int pwmLedChannelTFT = 0;  

// Variables for dino, lines, clouds, bumps, enemies, and gameplay
int dinoW=33;     // Dino width
int dinoH=35;     // Dino height
float linesX[6];  // X positions of ground lines (background)
int linesW[6];    // Widths of ground lines
float linesX2[6]; // X positions for second line layer
int linesW2[6];   // Widths of second ground lines
float clouds[2]={random(0,80),random(100,180)}; // Cloud positions
float bumps[2];   // Positions of bumps on the ground
int bumpsF[2];    // Variations of bump frames
int eW=18;        // Enemy width
int eH=38;        // Enemy height

float eX[2]={random(240,310),random(380,460)};  // Enemy X positions
int ef[2]={0,1};  // Current enemy frame

// ptero position
float pteroX = {random(240,300)};
int pteroY[2] = {60, 10};
int positionY= random(0,2);
bool show_ptero= false ;

// Game state variables
float sped=1.15;     // Speed of the game (increases as score increases)
int x=30;         // X position of the dino
int y=58;         // Y position of the dino (jumping)
float dir=-1.4;   // Direction of dino movement (used for jumping)
bool pressed=0;   // Tracks if the jump button is pressed
int frames=0;     // Animation frame counter
int f=0;      // Current dino frame
int f_ptero =0;     // current fdrame of
float cloudSpeed=0.4; // Speed of clouds
bool gameRun;       // Tracks if the game is running or over
int score=0;      // Player's score
int t=0;          // Time counter for speed increase
int press2=0;     // Controls brightness adjustments
int debut_milis=0; //variable pour chronomettrer

int brightnes[6]={70,100,130,160,200,220};  // Brightness levels
byte b=1;   // Current brightness setting

void setup() {
  // Initialize pins and TFT display
  pinMode(0, INPUT_PULLUP);
  pinMode(35, INPUT_PULLUP);
  tft.init();
  tft.setSwapBytes(true);  // Swap byte order for correct image display
  tft.fillScreen(TFT_WHITE); // Clear the screen to white
  tft.setRotation(1);  // Set screen rotation
  
  // Set text color and depth of sprite images
  img.setTextColor(TFT_BLACK, TFT_WHITE);
  //img.setColorDepth(1);   // Set bit depth for sprites (1 bit per pixel)
  //img2.setColorDepth(1);
  //e.setColorDepth(1);
  //e2.setColorDepth(1);
  
 
  // Create sprites for the dino, enemies, and background lines
  img.createSprite(240, 100);
  img2.createSprite(33, 35);
  e.createSprite(eW, eH);
  e2.createSprite(eW, eH);
  ptero.createSprite(pteroW, pteroH);
  tft.fillScreen(TFT_WHITE);

  // Set PWM brightness
  ledcWrite(pwmLedChannelTFT, brightnes[b]);

  // Initialize ground lines and bumps
  for (int i = 0; i < 6; i++) {
    linesX[i] = random(i * 40, (i + 1) * 40);
    linesW[i] = random(1, 14);
    linesX2[i] = random(i * 40, (i + 1) * 40);
    linesW2[i] = random(1, 14);
  }

  for (int n = 0; n < 2; n++) {
    bumps[n] = random(n * 90, (n + 1) * 120);
    bumpsF[n] = random(0, 2);
  }

  // Display "no internet" image before the game starts

  while (digitalRead(0) != 0) 
  {
    tft.pushImage(0, 0, 217, 135, noInternet);
    gameRun = 0;
  }
  tft.fillScreen(TFT_WHITE); // Clear screen when the game starts
  gameRun = 1;
}

void loop() {
  if (gameRun == 1) {  // If the game is running
    if (digitalRead(0) == 0 && pressed == 0) {  // Jump when button pressed
      pressed = 1;
      f = 0;  // Reset dino frame
    }

    // Handle jumping
    if (pressed == 1) {
      y = y + dir;  // Update dino's Y position (jumping)
      if (y == 2) dir = dir * -1.00;  // Invert direction when at peak
      if (y == 58) 
      {  // Stop jumping when dino lands
        pressed = 0;
        dir = dir * -1.00;
      }
    }

    // Update dino frame for running animation
    if (frames < 8 && pressed == 0) f = 1;
    if (frames > 8 && pressed == 0) f = 2;

    // ptero frame
    if (frames < 8) f_ptero = 0;
    if (frames > 8) f_ptero = 1;
    
    // Draw the scene
    drawS(x, y, f, f_ptero);
    f_ptero++;
    frames++;
    if (frames == 16) frames = 0;  // Reset frame counter after 16 frames

    // Check for collisions
    checkColision();
  }

  // Adjust screen brightness if pin 35 is pressed
  if (digitalRead(35) == 0) {
    if (press2 == 0) {
      press2 = 1;
      b++;
      if (b >= 6)
        b = 0;
      ledcWrite(pwmLedChannelTFT, brightnes[b]);
    }
  } else {
    press2 = 0;
  }
}

void drawS(int x, int y, int frame, int frame2) {
  // Clear previous sprite and draw ground lines
  img.fillSprite(TFT_WHITE);
  img.drawLine(0, 84, 240, 84, TFT_BLACK);

  // Move and redraw the ground lines
  for (int i = 0; i < 6; i++) {
    img.drawLine(linesX[i], 87, linesX[i] + linesW[i], 87, TFT_BLACK);
    linesX[i] -= sped;
    if (linesX[i] < -14) {
      linesX[i] = random(245, 280);
      linesW[i] = random(1, 14);
    }
    img.drawLine(linesX2[i], 98, linesX2[i] + linesW2[i], 98, TFT_BLACK);
    linesX2[i] -= sped;
    if (linesX2[i] < -14) {
      linesX2[i] = random(245, 280);
      linesW2[i] = random(1, 14);
    }
  }

  // Move and draw clouds
  for (int j = 0; j < 2; j++) {
    img.drawXBitmap(clouds[j], 20, cloud, 38, 11, TFT_BLACK, TFT_WHITE);
    clouds[j] -= cloudSpeed;
    if (clouds[j] < -40) clouds[j] = random(244, 364);
  }

  // Move and draw bumps (ground obstacles)
  for (int n = 0; n < 2; n++) {
    img.drawXBitmap(bumps[n], 80, bump[bumpsF[n]], 34, 5, TFT_BLACK, TFT_WHITE);
    bumps[n] -= sped;
    if (bumps[n] < -40) {
      bumps[n] = random(244, 364);
      bumpsF[n] = random(0, 2);
    }
  }

  // Move and draw enemies
  if (score >50){
    for (int m = 0; m < 2; m++) {
      eX[m] -= sped;
      if (eX[m] < -10) {
        eX[m] = random(350, 500);
        ef[m] = random(0, 2);
      }
    }
  }

  // show and move ptero
  if (score>= 100){
    if ((score % 100)==0 && show_ptero==false){ // logique hampiseho ptero
      show_ptero = true;
    }
    if (pteroX>-10 && show_ptero == true){ //mipotra le ptero
      ptero.pushImage(0, 0,pteroW  , pteroH, enemi_pterodactyl[frame2]);
      ptero.pushToSprite(&img, pteroX,pteroY[positionY],TFT_WHITE);
      pteroX= pteroX - sped;
    }
    if (pteroX<-10 && show_ptero == true){ // tsy mipotra le ptero
      pteroX = random(240,300);
      positionY= random(0,2);
      show_ptero = false;
    }
  }

  // Draw enemy sprites
  e.drawXBitmap(0, 0, enemy[0], eW, eH, TFT_BLACK, TFT_WHITE);
  //e2.drawXBitmap(0, 0, enemy[1], eW, eH, TFT_BLACK, TFT_WHITE);

  // Draw dino sprite based on the frame (running or jumping)
  img2.drawXBitmap(0, 0, dino[frame], 33, 35, TFT_BLACK, TFT_WHITE);

  // Push enemy and dino sprites to the screen
  e.pushToSprite(&img, eX[0], 56, TFT_WHITE);
  //e2.pushToSprite(&img, eX[1], 56, TFT_WHITE);
  img2.pushToSprite(&img, x, y, TFT_WHITE);

  if (gameRun==1)  score =millis() / 100; // Increment score with time
  // Draw score on the screen
  img.drawString(String(score), 204, 0, 2);

  // Increase game speed every 100 points
  if (score > t + 50) {
    if (score < 300){
    t = score;
    sped = sped + 0.35;
    cloudSpeed = cloudSpeed + 0.35;
    }
    else{
      sped = sped;
      cloudSpeed = cloudSpeed;
    }
  }

  // Push the entire frame to the display
  img.pushSprite(0, 17);
}

void checkColision() {
  // Check if dino collides with any enemies
  for (int i = 0; i < 2; i++) {
    if (eX[0] < x + dinoW / 2 && eX[0] > x && y > 25) {
      gameRun = 0;  // End game if collision detected
      tft.fillRect(0, 30, 240, 110, TFT_WHITE);  // Clear part of the screen
      tft.drawXBitmap(10, 30, gameover, 223, 100, TFT_BLACK, TFT_WHITE);  // Show "game over" image
      delay(500);
      }
    }
  if ((x < pteroX + pteroW/2)&&(pteroX < x + dinoW/2)) { //dinoW dinoH x y pteroX int pteroY[positionY] pteroW pteroH
    if((y<pteroY[positionY]+pteroH/2)&& (pteroY[positionY]< y+dinoH/2)){
      gameRun = 0;  // End game if collision detected
      tft.fillRect(0, 30, 240, 110, TFT_WHITE);  // Clear part of the screen
      tft.drawXBitmap(10, 30, gameover, 223, 100, TFT_BLACK, TFT_WHITE);  // Show "game over" image
      delay(500);
    }
  }
  
}